## board/freescale/mx6ull_yshun_emmc/Kconfig
```kconfig
if TARGET_MX6ULL_YSHUN_EMMC || TARGET_MX6ULL_9X9_EVK

config SYS_BOARD
	default "mx6ull_yshun_emmc"

config SYS_VENDOR
	default "freescale"

config SYS_SOC
	default "mx6"

config SYS_CONFIG_NAME
	default "mx6ull_yshun_emmc"

endif
```
